/ {
    esb_split {
        compatible = "zmk,esb-split";
        // These are arbitrary default addresses. In end user products
        // different addresses should be used for each set of devices.
        base-addr-0 = <0x12 0x34 0x56 0x78>;
        base-addr-1 = <0x9A 0xBC 0xDE 0xF0>;
        addr-prefix = <0x12 0x13 0x14 0x15 0x16 0x17 0x18 0x19>;
    };
};
