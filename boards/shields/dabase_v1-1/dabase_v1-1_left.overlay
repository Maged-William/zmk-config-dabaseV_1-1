/*
 * Copyright (c) 2022 Duccio Breschi
 *
 * SPDX-License-Identifier: MIT
 */

#include "dabase_v1-1.dtsi"
#include "dabase_v1-1_esb_addr.dtsi"

&kscan0 {
    diode-direction = "col2row";
    col-gpios
        = <&gpio1 11 GPIO_ACTIVE_HIGH>
        , <&gpio1 13 GPIO_ACTIVE_HIGH>
        , <&gpio1 15 GPIO_ACTIVE_HIGH>
        , <&gpio0 2  GPIO_ACTIVE_HIGH>
        , <&gpio0 29 GPIO_ACTIVE_HIGH>
        , <&gpio0 31 GPIO_ACTIVE_HIGH>
    ;

    row-gpios
        = <&gpio0 10  (GPIO_ACTIVE_HIGH | GPIO_PULL_DOWN)>
        , <&gpio0 9   (GPIO_ACTIVE_HIGH | GPIO_PULL_DOWN)>
        , <&gpio0 22  (GPIO_ACTIVE_HIGH | GPIO_PULL_DOWN)>
        , <&gpio0 24  (GPIO_ACTIVE_HIGH | GPIO_PULL_DOWN)>
        , <&gpio1 0   (GPIO_ACTIVE_HIGH | GPIO_PULL_DOWN)>
        , <&gpio0 11  (GPIO_ACTIVE_HIGH | GPIO_PULL_DOWN)>
        , <&gpio1 4   (GPIO_ACTIVE_HIGH | GPIO_PULL_DOWN)>
        , <&gpio1 7   (GPIO_ACTIVE_HIGH | GPIO_PULL_DOWN)>
    ;
};

&left_encoder {
    status = "okay";
};


&i2c0 {
    status = "okay";

    tps43: iqs5xx@74 {
        status = "okay";
        compatible = "azoteq,iqs5xx";
        reg = <0x74>;

        one-finger-tap;
        press-and-hold;
        press-and-hold-time = <250>;
        two-finger-tap;

        scroll;
        natural-scroll-y;
        natural-scroll-x;

        bottom-beta = <5>;
        stationary-threshold = <5>;

        switch-xy;

        reset-gpios = <&gpio1 4 GPIO_ACTIVE_LOW>; /* D8 / P1.04 */
        rdy-gpios = <&gpio1 6 GPIO_ACTIVE_HIGH>; /* D9 / P1.06 */
    };
};