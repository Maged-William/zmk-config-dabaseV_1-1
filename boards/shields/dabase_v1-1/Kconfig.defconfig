## boards/shields/dabase_v1-1/Kconfig.defconfig
```kconfig
if SHIELD_DABASE_V11_DONGLE

config ZMK_KEYBOARD_NAME
    default "DabaseV1.1"

config ZMK_SPLIT_ROLE_CENTRAL
    default y

config ZMK_SPLIT_BLE_CENTRAL_PERIPHERALS
    default 2

endif

config ZMK_SPLIT
    default y
```

## boards/shields/dabase_v1-1/Kconfig.shield
```kconfig
config SHIELD_DABASE_V11_LEFT
    def_bool $(shields_list_contains,dabase_v0-2_left)

config SHIELD_DABASE_V11_RIGHT
    def_bool $(shields_list_contains,dabase_v0-2_right)

config SHIELD_DABASE_V11_DONGLE
    def_bool $(shields_list_contains,dabase_v0-2_dongle)
```
