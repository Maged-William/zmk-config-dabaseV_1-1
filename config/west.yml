## config/west.yml
```yaml
manifest:
  remotes:
    # zmk official
    - name: zmkfirmware
      url-base: https://github.com/zmkfirmware
    - name: badjeff
      url-base: https://github.com/badjeff
    - name: nrfconnect
      url-base: https://github.com/nrfconnect
    - name: kmobs
      url-base: https://github.com/kmobs
    - name: janpfischer
      url-base: https://github.com/janpfischer
    - name: aym1607
      url-base: https://github.com/AYM1607
    - name: Maged-William
      url-base: https://github.com/Maged-William

  projects:
    - name: zmk
      remote: zmkfirmware
      revision: main
      import: app/west.yml
    - name: zmk-feature-split-esb
      remote: badjeff
      revision: main
    - name: sdk-nrf
      remote: badjeff
      revision: v3.1-branch+zmk-fixes
      path: nrf
    - name: nrfxlib
      remote: nrfconnect
      revision: v3.1-branch
      repo-path: sdk-nrfxlib
      path: nrfxlib
    - name: zmk-prospector # <--- and these
      remote: kmobs # <---
      revision: newstatus
    - name: zmk-driver-azoteq-iqs5xx
      remote: aym1607
      revision: main
    - name: dabasev11-zmk-module
      remote: Maged-William
      revision: main

self:
  path: config
```
